# file: ECSE444_lab1.ioc
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Mcu.Family=STM32L4
Mcu.Name=STM32L475V(C-E-G)Tx
Mcu.Package=LQFP100
NVIC.PriorityGroup=NVIC_PRIORITYGROUP_4
PA13\ (JTMS-SWDIO).Signal=SYS_JTMS-SWDIO
PB3\ (JTDO-TRACESWO).Signal=SYS_JTDO-SWO
ProjectManager.HeapSize=0x200
ProjectManager.StackSize=0x400
ProjectManager.TargetToolchain=STM32CubeIDE
RCC.ADCFreq_Value=48000000
RCC.AHBFreq_Value=80000000
RCC.APB1Freq_Value=80000000
RCC.APB1TimFreq_Value=80000000
RCC.APB2Freq_Value=80000000
RCC.APB2TimFreq_Value=80000000
RCC.CortexFreq_Value=80000000
RCC.HCLKFreq_Value=80000000
RCC.HSE_VALUE=8000000
RCC.HSI_VALUE=16000000
RCC.MSI_VALUE=4000000
RCC.PLLN=40
RCC.PLLSAI1N=24
RCC.SYSCLKFreq_VALUE=80000000
RCC.SYSCLKSource=RCC_SYSCLKSOURCE_PLLCLK
RCC.USBFreq_Value=48000000
RCC.VCOOutputFreq_Value=160000000
board=B-L475E-IOT01A1

// file: Src/main.c
/* USER CODE BEGIN Header */
/**
  ******************************************************************************
  * @file           : main.c
  * @brief          : Main program body
  ******************************************************************************
  * @attention
  *
  * Copyright (c) 2022 STMicroelectronics.
  * All rights reserved.
  *
  * This software is licensed under terms that can be found in the LICENSE file
  * in the root directory of this software component.
  * If no LICENSE file comes with this software, it is provided AS-IS.
  *
  ******************************************************************************
  */
/* USER CODE END Header */
#include "main.h"
#include <stdio.h>
#include <stdlib.h>

/* USER CODE BEGIN Includes */
#define ARM_MATH_CM4
#include "arm_math.h"

#include "lab1math.h"
/* USER CODE END Includes */

/* USER CODE BEGIN PD */
#define ITM_Port32(n) (*((volatile unsigned long *) (0xE0000000+4*n)))
/* USER CODE END PD */

void SystemClock_Config(void);
static void MX_GPIO_Init(void);

int main(void)
{

  /* MCU Configuration--------------------------------------------------------*/

  /* Reset of all peripherals, Initializes the Flash interface and the Systick. */
  HAL_Init();

  /* Configure the system clock */
  SystemClock_Config();

  /* Initialize all configured peripherals */
  MX_GPIO_Init();
  /* USER CODE BEGIN 2 */
  // define our variables and array
  float maxC = 0;
  uint32_t maxIndexC;
  float maxAsm = 0;
  uint32_t maxIndexAsm;
  float maxCMSIS = 0;
  uint32_t maxIndexCMSIS;

  float stdC = 0;
  float stdAsm = 0;
  float stdCMSIS = 0;

  // the max is 88.49 at index 5
  float array[10] = {10, 12, 23, 23, 16, 23, 21, 16, 80, 77};
//  float array2[10] = {48.21, 79.48, 24.27, 28.82, 78.24, 88.49, 31.19, 5.52, 82.70, 77.73};

//  float array[1000];
//  srand(0);
//  for (int i = 0; i < 1000; i++) {
//	  array[i] = (float)rand()/(float)(RAND_MAX/1000.0);
//  }

  uint32_t arrSize = sizeof(array)/sizeof(array[0]);
  float multRes[arrSize];
  float multResC[arrSize];
  float multResAsm[arrSize];

  /* USER CODE END 2 */

  /* Infinite loop */
  while (1)
  {

    /* USER CODE BEGIN 3 */

	// max val of array
	//-------------------------------------------------------------------------
	ITM_Port32(31) = 1;
	for (uint32_t i=0; i<1000; i++)
	  cMax(array, arrSize, &maxC, &maxIndexC); // C
	ITM_Port32(31) = 2;
	for (uint32_t i=0; i<1000; i++)
	  asmMax(array, arrSize, &maxAsm, &maxIndexAsm); // Assembly
	ITM_Port32(31) = 3;
	for (uint32_t i=0; i<1000; i++)
	  arm_max_f32(array, arrSize, &maxCMSIS, &maxIndexCMSIS); //CMSIS
	ITM_Port32(31) = 4;

	// element-wise 1d matrix multiplication
	//-------------------------------------------------------------------------
	for (uint32_t i=0; i<1000; i++)
   	  cMult(array, array, multResC, arrSize); //C
	ITM_Port32(31) = 5;
	for (uint32_t i=0; i<1000; i++)
	  asmMult(array, array, multResAsm, arrSize); // Assembly
	ITM_Port32(31) = 6;
	for (uint32_t i=0; i<1000; i++)
	  arm_mult_f32(array, array, multRes, arrSize); //CMSIS
	ITM_Port32(31) = 7;

	// Standard deviation
	//-------------------------------------------------------------------------
	for (uint32_t i=0; i<1000; i++)
	  cStd(array, arrSize, &stdC); //C
	ITM_Port32(31) = 8;
	for (uint32_t i=0; i<1000; i++)
	  asmStd(array, arrSize, &stdAsm); //Assembly
	ITM_Port32(31) = 9;
	for (uint32_t i=0; i<1000; i++)
	  arm_std_f32(array, arrSize, &stdCMSIS); //CMSIS
	ITM_Port32(31) = 10;
	ITM_Port32(31) = 11;

  }
  /* USER CODE END 3 */
}

void SystemClock_Config(void)
{
  RCC_OscInitTypeDef RCC_OscInitStruct = {0};
  RCC_ClkInitTypeDef RCC_ClkInitStruct = {0};

  /** Configure the main internal regulator output voltage
  */
  if (HAL_PWREx_ControlVoltageScaling(PWR_REGULATOR_VOLTAGE_SCALE1) != HAL_OK)
  {
    Error_Handler();
  }

  /** Initializes the RCC Oscillators according to the specified parameters
  * in the RCC_OscInitTypeDef structure.
  */
  RCC_OscInitStruct.OscillatorType = RCC_OSCILLATORTYPE_MSI;
  RCC_OscInitStruct.MSIState = RCC_MSI_ON;
  RCC_OscInitStruct.MSICalibrationValue = 0;
  RCC_OscInitStruct.MSIClockRange = RCC_MSIRANGE_6;
  RCC_OscInitStruct.PLL.PLLState = RCC_PLL_ON;
  RCC_OscInitStruct.PLL.PLLSource = RCC_PLLSOURCE_MSI;
  RCC_OscInitStruct.PLL.PLLM = 1;
  RCC_OscInitStruct.PLL.PLLN = 40;
  RCC_OscInitStruct.PLL.PLLP = RCC_PLLP_DIV7;
  RCC_OscInitStruct.PLL.PLLQ = RCC_PLLQ_DIV2;
  RCC_OscInitStruct.PLL.PLLR = RCC_PLLR_DIV2;
  if (HAL_RCC_OscConfig(&RCC_OscInitStruct) != HAL_OK)
  {
    Error_Handler();
  }

  /** Initializes the CPU, AHB and APB buses clocks
  */
  RCC_ClkInitStruct.ClockType = RCC_CLOCKTYPE_HCLK|RCC_CLOCKTYPE_SYSCLK
                              |RCC_CLOCKTYPE_PCLK1|RCC_CLOCKTYPE_PCLK2;
  RCC_ClkInitStruct.SYSCLKSource = RCC_SYSCLKSOURCE_PLLCLK;
  RCC_ClkInitStruct.AHBCLKDivider = RCC_SYSCLK_DIV1;
  RCC_ClkInitStruct.APB1CLKDivider = RCC_HCLK_DIV1;
  RCC_ClkInitStruct.APB2CLKDivider = RCC_HCLK_DIV1;

  if (HAL_RCC_ClockConfig(&RCC_ClkInitStruct, FLASH_LATENCY_4) != HAL_OK)
  {
    Error_Handler();
  }
}

static void MX_GPIO_Init(void)
{

  /* GPIO Ports Clock Enable */
  __HAL_RCC_GPIOA_CLK_ENABLE();
  __HAL_RCC_GPIOB_CLK_ENABLE();

}

void Error_Handler(void)
{
  __disable_irq();
  while (1)
  {
  }
}
